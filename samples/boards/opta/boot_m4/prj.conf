## CMakeLists.txt
```
# SPDX-License-Identifier: Apache-2.0

cmake_minimum_required(VERSION 3.20.0)
find_package(Zephyr REQUIRED HINTS $ENV{ZEPHYR_BASE})
project(opta_boot_m4)

FILE(GLOB app_sources src/*.c)
target_sources(app PRIVATE ${app_sources})
```

## sample.yaml
```
sample:
  description: Boot the M4 processor
  name: opta_boot_m4
tests:
  sample.boards.opta.boot_m4:
    build_only: true
    platform_allow: arduino_opta
    tags:
      - board
```

## prj.conf
```kconfig
CONFIG_GPIO=y

# Disable the USB ACM console.
CONFIG_SERIAL=n
CONFIG_CONSOLE=n
CONFIG_UART_CONSOLE=n
CONFIG_UART_LINE_CTRL=n
CONFIG_USB_DEVICE_STACK=n
```

## app.overlay
```dts
/* Disable some subsystems to allow M4 to used them. */
&usbotg_fs {
	status = "disabled";
};

&cdc_acm_uart0 {
	status = "disabled";
};
```

## src/main.c
```c
/*
 * Copyright (c) 2016 Intel Corporation
 * Copyright (c) 2024 DNDG srl
 *
 * SPDX-License-Identifier: Apache-2.0
 */

#include <stdio.h>
#include <zephyr/kernel.h>
#include <zephyr/drivers/gpio.h>
#include <stm32h7xx_ll_rcc.h>
#include <stm32h7xx_ll_system.h>

/* The devicetree node identifier for the green led over reset button. */
#define LED_RESET_NODE DT_NODELABEL(led_reset)

/* Unfortunately we cannot use the M4 device tree from M7 code and we need
 * to hardcode the M4 boot address here. */
#define M4_BOOT_ADDRESS 0x08180000

static const struct gpio_dt_spec led = GPIO_DT_SPEC_GET(LED_RESET_NODE, gpios);

int main(void)
{
	int ret;

	if (!gpio_is_ready_dt(&led)) {
		return 0;
	}

	ret = gpio_pin_configure_dt(&led, GPIO_OUTPUT_ACTIVE);
	if (ret < 0) {
		return 0;
	}

	// Boot the M4.
	LL_SYSCFG_SetCM4BootAddress0(M4_BOOT_ADDRESS >> 16);
	LL_RCC_ForceCM4Boot();

	while (1) {
		ret = gpio_pin_toggle_dt(&led);
		if (ret < 0) {
			return 0;
		}
		k_msleep(1000);
	}
	return 0;
}
```
